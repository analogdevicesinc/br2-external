## configs/microblaze_adi_defconfig
```kconfig
BR2_microblazeel=y
BR2_TOOLCHAIN_EXTERNAL=y
BR2_TOOLCHAIN_EXTERNAL_BOOTLIN_MICROBLAZEEL_UCLIBC_STABLE=y
BR2_TARGET_OPTIMIZATION="-mcpu=v11.0 -mxl-barrel-shift -mxl-pattern-compare -mno-xl-soft-mul -mxl-multiply-high -mno-xl-soft-div -msoft-float"
BR2_OPTIMIZE_FAST=y
BR2_TARGET_GENERIC_ROOT_PASSWD="analog"
BR2_ROOTFS_POST_BUILD_SCRIPT="$(BR2_EXTERNAL_ADI_PATH)/board/adi/microblaze/common/post-build.sh"
BR2_LINUX_KERNEL=y
BR2_LINUX_KERNEL_CUSTOM_GIT=y
BR2_LINUX_KERNEL_CUSTOM_REPO_URL="http://github.com/analogdevicesinc/linux"
BR2_LINUX_KERNEL_CUSTOM_REPO_VERSION="611544929b622f2bbb0744a42343d4f283bcaa19"
BR2_LINUX_KERNEL_DEFCONFIG="adi_mb_apollo"
BR2_LINUX_KERNEL_INTREE_DTS_NAME="vcu118_ad9084_204C_M4_L8_NP16_20p0_4x4"
BR2_PACKAGE_LIBTOMCRYPT=y
BR2_PACKAGE_OPENSSL=y
BR2_PACKAGE_LIBAIO=y
BR2_PACKAGE_LIBIIO=y
# BR2_PACKAGE_LIBIIO_USB_BACKEND is not set
# BR2_PACKAGE_LIBIIO_SERIAL_BACKEND is not set
BR2_PACKAGE_LIBIIO_TESTS=y
BR2_PACKAGE_AVAHI=y
BR2_PACKAGE_AVAHI_DAEMON=y
BR2_PACKAGE_AVAHI_LIBDNSSD_COMPATIBILITY=y
BR2_PACKAGE_DROPBEAR=y
BR2_PACKAGE_DROPBEAR_LOCALOPTIONS_FILE="$(BR2_EXTERNAL_ADI_PATH)/board/adi/pluto/dropbrear_localoptions.h"
BR2_PACKAGE_DROPBEAR_PREGENERATED_KEYS=y
BR2_PACKAGE_ETHTOOL=y
BR2_PACKAGE_GESFTPSERVER=y
BR2_PACKAGE_MII_DIAG=y
BR2_PACKAGE_PHYTOOL=y
BR2_TARGET_ROOTFS_CPIO_GZIP=y
BR2_TARGET_ROOTFS_INITRAMFS=y
# BR2_TARGET_ROOTFS_TAR is not set
BR2_PACKAGE_LIBINI=y
BR2_PACKAGE_FRU_TOOLS=y
BR2_PACKAGE_JESD204B_STATUS=y
```

## configs/microblaze_adi_rootfs_defconfig
```kconfig
BR2_microblazeel=y
BR2_TOOLCHAIN_EXTERNAL=y
BR2_TOOLCHAIN_EXTERNAL_BOOTLIN_MICROBLAZEEL_UCLIBC_STABLE=y
BR2_TARGET_OPTIMIZATION="-mcpu=v11.0 -mxl-barrel-shift -mxl-pattern-compare -mno-xl-soft-mul -mxl-multiply-high -mno-xl-soft-div -msoft-float"
BR2_OPTIMIZE_FAST=y
BR2_TARGET_GENERIC_ROOT_PASSWD="analog"
BR2_ROOTFS_POST_BUILD_SCRIPT="$(BR2_EXTERNAL_ADI_PATH)/board/adi/microblaze/common/post-build.sh"
BR2_PACKAGE_LIBTOMCRYPT=y
BR2_PACKAGE_OPENSSL=y
BR2_PACKAGE_LIBAIO=y
BR2_PACKAGE_LIBIIO=y
# BR2_PACKAGE_LIBIIO_USB_BACKEND is not set
# BR2_PACKAGE_LIBIIO_SERIAL_BACKEND is not set
BR2_PACKAGE_LIBIIO_TESTS=y
BR2_PACKAGE_AVAHI=y
BR2_PACKAGE_AVAHI_DAEMON=y
BR2_PACKAGE_AVAHI_LIBDNSSD_COMPATIBILITY=y
BR2_PACKAGE_DROPBEAR=y
BR2_PACKAGE_DROPBEAR_LOCALOPTIONS_FILE="$(BR2_EXTERNAL_ADI_PATH)/board/adi/pluto/dropbrear_localoptions.h"
BR2_PACKAGE_DROPBEAR_PREGENERATED_KEYS=y
BR2_PACKAGE_ETHTOOL=y
BR2_PACKAGE_GESFTPSERVER=y
BR2_PACKAGE_MII_DIAG=y
BR2_PACKAGE_PHYTOOL=y
BR2_TARGET_ROOTFS_CPIO=y
BR2_TARGET_ROOTFS_CPIO_GZIP=y
BR2_PACKAGE_LIBINI=y
BR2_PACKAGE_FRU_TOOLS=y
BR2_PACKAGE_JESD204B_STATUS=y
```
